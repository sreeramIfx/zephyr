## boards/infineon/cyw920829m2evk_02/Kconfig.defconfig
```kconfig
# The Infineon AIROC™ CYW20829 Bluetooth® LE evaluation kit (CYW92089M2EVK-02)

# Copyright (c) 2024 Cypress Semiconductor Corporation.
# SPDX-License-Identifier: Apache-2.0

choice BT_HCI_BUS_TYPE
	default BT_CYW208XX if BT
endchoice

choice AIROC_PART
	default CYW20829 if BT
endchoice

# Heap Pool Size
config HEAP_MEM_POOL_ADD_SIZE_BOARD
	int
	default 10096
```

## dts/bindings/bluetooth/infineon,cyw208xx-hci.yaml
```yaml
# Copyright (c) 2024 Cypress Semiconductor Corporation (an Infineon company) or
# an affiliate of Cypress Semiconductor Corporation
#
# SPDX-License-Identifier: Apache-2.0

description: |
    Bluetooth module that uses Infineon CYW208XX HCI bluetooth interface

compatible: "infineon,cyw208xx-hci"

include: base.yaml
```

## samples/bluetooth/beacon/sample.yaml
```yaml
sample:
  name: Bluetooth Beacon
tests:
  sample.bluetooth.beacon:
    harness: bluetooth
    platform_allow:
      - qemu_cortex_m3
      - qemu_x86
      - nrf52dk/nrf52832
      - cyw920829m2evk_02
    tags: bluetooth
    integration_platforms:
      - qemu_cortex_m3

  sample.bluetooth.beacon-coex:
    extra_args: CONF_FILE="prj-coex.conf"
    harness: bluetooth
    platform_allow: nrf52840dk/nrf52840
    tags: bluetooth
```
